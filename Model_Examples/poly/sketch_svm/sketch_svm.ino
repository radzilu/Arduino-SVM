#include <avr/pgmspace.h>
#define VEC_DIM 9

#define SVM_TYPE c_svc
#define KERNEL_TYPE polynomial
#define DEGREE 3
#define GAMMA 0.111111
#define COEF0 0
#define NR_CLASS 5
#define TOTAL_SV 50
const  PROGMEM float rho[] = {0.433865, 0.326431, 0.196373, 0.320688, 0.00433523, -0.079755, -0.0990719, -0.0673645, -0.107552, -0.0543994};
const int label[] = {0, 1, 2, 3, 4};
const int nr_sv[] = {10, 10, 10, 10, 10};
 const PROGMEM float yalpha1[10 * (NR_CLASS-1)] = {1, 1, 1, 1, 1, 1, 1, 1, 1, 1, 1, 1, 1,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 1, 1}; 

 const PROGMEM float sv1[10 * VEC_DIM] = {0.114754, 0.583333, 0.676768, 0.676768, 0.547826, 0.622222, 0.655172, 0.666667, 0.52381, 0.0983607, 0.791667, 0.79798, 0.717172,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 0.85, 0.980952}; 

 const PROGMEM float yalpha2[10 * (NR_CLASS-1)] = {1, -1, -1, -1, -1, -1, -1, -1, -1, -1, 1, 1, 1,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 1, 1}; 

 const PROGMEM float sv2[10 * VEC_DIM] = {0.213115, 0.847222, 0.919192, 0.616162, 0.46087, 0.711111, 0.431034, 0.85, 0.980952, 0.47541, 0.0416667, 0.212121, 0.838384,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 -0.566667, 0.809524}; 

 const PROGMEM float yalpha3[10 * (NR_CLASS-1)] = {-1, -1, -1, -1, -1, -1, -1, -1, -1, -1, 1, 1, -1,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 1, 1}; 

 const PROGMEM float sv3[10 * VEC_DIM] = {0.262295, 0.472222, -0.232323, 0.414141, 0.86087, 0.444444, 0.293103, -0.566667, 0.809524, 0.180328, 0.138889, 0.757576, 0.818182,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 -0.833333, -0.390476}; 

 const PROGMEM float yalpha4[10 * (NR_CLASS-1)] = {-1, -1, -1, -1, -1, -1, -1, -1, -1, -0, -1, -1, -1,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 1, 1}; 

 const PROGMEM float sv4[10 * VEC_DIM] = {-0.0983607, -0.847222, -0.89899, -0.414141, 0.391304, 0.111111, -0.931034, -0.833333, -0.390476, -0.196721, -0.875, -0.252525, 1,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 -0.516667, -0.561905}; 

 const PROGMEM float yalpha5[10 * (NR_CLASS-1)] = {-0, -1, -1, -1, -1, -1, -1, -1, -1, -1, -1, -1, -1,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 -1, -1}; 

 const PROGMEM float sv5[10 * VEC_DIM] = {-0.918033, -0.944444, -0.414141, -0.69697, -0.217391, -1, -0.534483, -0.516667, -0.561905, -1, -1, -0.79798, -0.454545,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 -0.416667, -0.352381}; 

const int scalePar[] = {-1,1};
const int low[] = {517,544,543,546,733,576,552,526,552};
const int high[] = {639,688,642,645,848,666,668,646,657};  
int result[NR_CLASS]={0};

 float const* const supportVectors[NR_CLASS] PROGMEM = {
sv1, sv2, sv3, sv4, sv5, };
 const float* const valuesForSupport[NR_CLASS] PROGMEM = {
yalpha1, yalpha2, yalpha3, yalpha4, yalpha5, };

void scale(const int* sensor, float* scaledSensor){
  for(int p=0; p<VEC_DIM;p++){
    scaledSensor[p] = (float)scalePar[0] +((float)scalePar[1] -((float)scalePar[0]))*((float)sensor[p]-(float)low[p])/((float)high[p]-(float)low[p]);
  }
}

inline void svm_predict(int sensor[]){
  int recognizedClass = 1;
  float scaledSensor[VEC_DIM];
  scale(sensor,scaledSensor);
  int rhoCounter = 0;


  for(int i=0; i<NR_CLASS; i++){
    for(int j=i+1; j<NR_CLASS; j++){
      float accumulator = 0;


      float* sv_class1 = (float*) pgm_read_word(supportVectors + i);
      float* sv_class2 = (float*) pgm_read_word(supportVectors + j);
      float* coeffs1   = (float*) pgm_read_word(valuesForSupport + i) + nr_sv[i] * (j-1);
     float* coeffs2   = (float*) pgm_read_word(valuesForSupport + j) + nr_sv[j] * i;


      accumulator += svm_evaluate(nr_sv[i], coeffs1, sv_class1, scaledSensor);
      accumulator += svm_evaluate(nr_sv[j], coeffs2, sv_class2, scaledSensor);


      float rhoNr = pgm_read_float(rho + rhoCounter);
      accumulator -= rhoNr;


      if (accumulator > 0) {
        result[i]++;
      } else {
        result[j]++;
      }
      rhoCounter++;
    }
  }


  int temp = 0;
  for(int t = 0; t < NR_CLASS; t++){
    if(result[temp] <= result[t]){
      recognizedClass = t;
      temp = t;
    }
  }


  Serial.println(recognizedClass, DEC);
  delay(500);
  for(int q = 0; q < NR_CLASS; q++){
    result[q]=0;
  }
}
